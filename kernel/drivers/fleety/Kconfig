## kernel/drivers/fleety/Kconfig
```kconfig
menuconfig FLEETY_DRIVERS
	bool "Fleety Drivers"
	default n
	---help---
	  This option allows you to select a number of drivers that fleety.

if FLEETY_DRIVERS

source "drivers/fleety/spider/Kconfig"
source "drivers/fleety/leds/Kconfig"
source "drivers/fleety/keys/Kconfig"

endif # FLEETY_DRIVERS
```

## kernel/drivers/fleety/keys/Kconfig
```kconfig
config FLEETY_KEYS
	tristate "The Fleety Keys Driver"
	default n
	help
	  This is the key(gpio) driver.
```

## kernel/drivers/fleety/leds/Kconfig
```kconfig
config FLEETY_LEDS
	tristate "The Fleety Leds Driver"
	default n
	help
	  This is the leds driver.
```

## kernel/drivers/fleety/spider/Kconfig
```kconfig
config FLEETY_SPIDER
	tristate "The Fleety Spider Driver"
	default n
	help
	  This is the monitor driver for fleety.
```

## kernel/drivers/input/touchscreen/gt9xx/Kconfig
```kconfig
config TOUCHSCREEN_GT9XX
	tristate "GT9xx touchscreens support."
	default y
	help
	  This is the touchscreen driver for fleety.
```

## kernel/drivers/video/msm/mdss/Kconfig
```kconfig
config FB_MSM_MDSS_WRITEBACK
	bool "MDSS Writeback Panel"
	---help---
	The MDSS Writeback Panel provides support for routing the output of
	MDSS frame buffer driver and MDP processing to memory.

# FLEETY_DRIVERS start
config MSM_M2R
	bool "MDSS display bridge chip ICN6211"
	---help---
	add display bridge icn6211 driver for rgb panel item

config MSM_LCD_RGB
	bool "MDSS display panel RGB LCD"
	select MSM_M2R
	---help---
	add rgb panel driver
# FLEETY_DRIVERS end

config FB_MSM_MDSS_HDMI_PANEL
	depends on FB_MSM_MDSS
	bool "MDSS HDMI Tx Panel"
	default n
	---help---
	The MDSS HDMI Panel provides support for transmitting TMDS signals of
	MDSS frame buffer data to connected hdmi compliant TVs, monitors etc.

config FB_MSM_MDSS_HDMI_MHL_SII8334
	depends on FB_MSM_MDSS_HDMI_PANEL
	bool 'MHL SII8334 support '
	default n
	---help---
	  Support the HDMI to MHL conversion.
	  MHL (Mobile High-Definition Link) technology
	  uses USB connector to output HDMI content

config FB_MSM_MDSS_DSI_CTRL_STATUS
	tristate "DSI controller status check feature"
	---help---
	  Check DSI controller status periodically (default period is 5
	  seconds) by sending Bus-Turn-Around (BTA) command. If DSI controller
	  fails to acknowledge the BTA command, it sends PANEL_ALIVE=0 status
	  to HAL layer to reset the controller.

config FB_MSM_MDSS_EDP_PANEL
	depends on FB_MSM_MDSS
	bool "MDSS eDP Panel"
	---help---
	The MDSS eDP Panel provides support for eDP host controller driver
	which runs in Video mode only and is responsible for transmitting
	frame buffer from host SOC to eDP display panel.

config MSM8909_0_SUPPORT_HD
	default n
	bool "crack for MSM8909-0 support HD"
	---help---
	The MSM8909-0 chip not support HD,so need crack!

config FB_MSM_MDSS_MDP3
	depends on FB_MSM_MDSS
	bool "MDP3 display controller"
	---help---
	The MDP3 provides support for an older version display controller
	included in latest display sub-system, known as MDSS.
```
