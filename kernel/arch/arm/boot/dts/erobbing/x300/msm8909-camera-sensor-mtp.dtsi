/*
 * Copyright (c) 2014-2015, The Linux Foundation. All rights reserved.
 *
 * This program is free software; you can redistribute it and/or modify
 * it under the terms of the GNU General Public License version 2 and
 * only version 2 as published by the Free Software Foundation.
 *
 * This program is distributed in the hope that it will be useful,
 * but WITHOUT ANY WARRANTY; without even the implied warranty of
 * MERCHANTABILITY or FITNESS FOR A PARTICULAR PURPOSE.  See the
 * GNU General Public License for more details.
 */

&soc {
};

&i2c_3 {
	
	actuator0: qcom,actuator@0 {
		cell-index = <0>;
		reg = <0x3>;
		compatible = "qcom,actuator";
		cam_vaf-supply = <&pm8909_l8>;
		qcom,cam-vreg-name = "cam_vaf";
		qcom,cam-vreg-type = <0>;
		qcom,cam-vreg-min-voltage = <2850000>;
		qcom,cam-vreg-max-voltage = <2900000>;
		qcom,cam-vreg-op-mode = <80000>;
	};
/*		
	eeprom0: qcom,eeprom@6c{
		cell-index = <0>;
		reg = <0x6c>;
		qcom,eeprom-name = "ov8858_his_qtech_bj";
		compatible = "qcom,msm_eeprom";
		qcom,slave-addr = <0x20>;
		qcom,num-blocks = <7>;
		
		qcom,page0 = <1 0x0100 2 0x01 1 1>;
		qcom,poll0 = <0 0x0 2 0 1 1>;
		qcom,mem0 = <0 0x0 2 0 1 0>;
		
		qcom,page1 = <1 0x5002 2 0x00 1 1>;
		qcom,poll1 = <0 0x0 2 0 1 1>;
		qcom,mem1 = <0 0x0 2 0 1 0>;
			
		qcom,page2 = <1 0x3d84 2 0xc0 1 1>;
		qcom,poll2 = <0 0x0 2 0 1 1>;
		qcom,mem2 = <0 0x3d00 2 0 1 0>;
		
		qcom,page3 = <1 0x3d88 2 0x7010 2 1>;
		qcom,poll3 = <0 0x0 2 0 1 1>;
		qcom,mem3 = <0 0x3d00 2 0 1 0>;
		
		qcom,page4 = <1 0x3d8A 2 0x720a 2 1>;
		qcom,pageen4 = <1 0x3d81 2 0x01 1 10>;
		qcom,poll4 = <0 0x0 2 0 1 1>;
		qcom,mem4 = <507 0x7010 2 0 1 1>;
		
		qcom,page5 = <1 0x5002 2 0x08 1 1>;
		qcom,poll5 = <0 0x0 2 0 1 1>;
		qcom,mem5 = <0 0x0 2 0 1 0>;
		
		qcom,page6 = <0 0x5002 2 0x08 1 1>;
		qcom,poll6 = <0 0x0 2 0 1 1>;
		qcom,mem6 = <1 0x5000 2 0 1 1>;
		
		cam_avdd_vodd-supply = <&cam_avdd_vodd>;		
		qcom,cam-vreg-name = " ", "cam_avdd_vodd", " "," "; 
		qcom,cam-vreg-min-voltage = <1200000 1800000 2800000 2850000>;
		qcom,cam-vreg-max-voltage = <1200000 1800000 2850000 2900000>;
		qcom,cam-vreg-op-mode = <200000 80000 80000 100000>;
		qcom,enable_pinctrl;
		pinctrl-names = "cam_default", "cam_suspend";
		pinctrl-0 = <&cam_sensor_mclk0_default
					&cam_sensor_rear_default>;
		pinctrl-1 = <&cam_sensor_mclk0_sleep &cam_sensor_rear_sleep>;
		gpios = <&msm_gpio 26 0>,
			<&msm_gpio 35 0>,
			<&msm_gpio 34 0>;
		qcom,gpio-reset = <1>;
		qcom,gpio-standby = <2>;
		qcom,gpio-req-tbl-num = <0 1 2>;
		qcom,gpio-req-tbl-flags = <1 0 0>;
		qcom,gpio-req-tbl-label = "CAM0_MCLK",
						"CAM0_RESET",
						"CAM0_STANDBY";
		qcom,cam-power-seq-type = "sensor_gpio","sensor_gpio","sensor_gpio","sensor_vreg","sensor_gpio", "sensor_clk","sensor_i2c_mux";
		qcom,cam-power-seq-val = "sensor_gpio_standby","sensor_gpio_reset","sensor_gpio_standby","cam_avdd_vodd","sensor_gpio_reset","sensor_cam_mclk","none";
		qcom,cam-power-seq-cfg-val = <0 0 1 1 1 24000000 0>;
		qcom,cam-power-seq-delay = <1 1 3 3 5 5 0>;
		clocks = <&clock_gcc clk_mclk0_clk_src>,
			<&clock_gcc clk_gcc_camss_mclk0_clk>;
		clock-names = "cam_src_clk", "cam_clk";
	};
	*/

	led_flash0: qcom,led-flash@6e {
		cell-index = <0>;
		reg = <0x6e>;
		qcom,slave-id = <0x6e 0x00 0x0011>;
		compatible = "eu,eup2471";
		label = "eup2471";
		qcom,flash-type = <1>;
		cam_avdd_vodd-supply = <&cam_avdd_vodd>;		
		qcom,cam-vreg-name = "cam_avdd_vodd";	
		qcom,gpio-no-mux = <0>;
		qcom,enable_pinctrl;
		qcom,enable_gpio_power_en;
		pinctrl-names = "cam_flash_default", "cam_flash_suspend";
		pinctrl-0 = <&cam_sensor_flash_default>;
		pinctrl-1 = <&cam_sensor_flash_sleep>;
		gpios = <&msm_gpio 31 0>,
			<&msm_gpio 68 0>;
		qcom,gpio-flash-en = <0>;
		qcom,gpio-flash-now = <1>;
		qcom,gpio-req-tbl-num = <0 1>;
		qcom,gpio-req-tbl-flags = <0 0>;
		qcom,gpio-req-tbl-label = "FLASH_EN",
			"FLASH_NOW";

	};
	/*
	qcom,camera@0{
		cell-index = <0>;
		compatible = "qcom,camera";
		reg = <0x2>;
		qcom,csiphy-sd-index = <0>;
		qcom,csid-sd-index = <0>;
		qcom,mount-angle = <90>;
		qcom,actuator-src = <&actuator0>;  
		qcom,led-flash-src = <&led_flash0>;
		//qcom,eeprom-src = <&eeprom0>;
		cam_vaf-supply = <&pm8909_l8>;
		cam_avdd_vodd-supply = <&cam_avdd_vodd>;
		qcom,cam-vreg-name = " ", "cam_avdd_vodd", " ",	"cam_vaf";
		//qcom,cam-vreg-type = <0 1 1 0>;   
		qcom,cam-vreg-min-voltage = <1200000 1800000 2800000 2850000>;
		qcom,cam-vreg-max-voltage = <1200000 1800000 2850000 2900000>;
		qcom,cam-vreg-op-mode = <200000 80000 80000 100000>;
		pinctrl-names = "cam_default", "cam_suspend";
		pinctrl-0 = <&cam_sensor_mclk0_default
				&cam_sensor_rear_default>;
		pinctrl-1 = <&cam_sensor_mclk0_sleep &cam_sensor_rear_sleep>;
		gpios = <&msm_gpio 26 0>,
			<&msm_gpio 35 0>,
			<&msm_gpio 34 0>;
		qcom,gpio-reset = <1>;
		qcom,gpio-standby = <2>;
		qcom,gpio-req-tbl-num = <0 1 2>;
		qcom,gpio-req-tbl-flags = <1 0 0>;
		qcom,gpio-req-tbl-label = "CAM0_MCLK",
			"CAM0_RESET",
			"CAM0_STANDBY";
		qcom,sensor-position = <0>;
		qcom,sensor-mode = <0>;
		status = "ok";
		clocks = <&clock_gcc clk_mclk0_clk_src>,
				<&clock_gcc clk_gcc_camss_mclk0_clk>;
		clock-names = "cam_src_clk", "cam_clk";
	};
	*/

/*
	qcom,camera@1 {
		cell-index = <1>;
		compatible = "qcom,camera";
		reg = <0x1>;
		qcom,csiphy-sd-index = <0>;
		qcom,csid-sd-index = <0>; 
		qcom,mount-angle = <90>;
		cam_avdd_vodd-supply = <&cam_avdd_vodd>;
		qcom,cam-vreg-name = " ", "cam_avdd_vodd", " ";
		//qcom,cam-vreg-type = <0 1 2 >; 
		qcom,cam-vreg-min-voltage = <2800000 1800000 2850000 >;
		qcom,cam-vreg-max-voltage = <2800000 1800000 2850000 >;
		qcom,cam-vreg-op-mode = <200000 80000 80000 >;  
		pinctrl-names = "cam_default", "cam_suspend";
		pinctrl-0 = <&cam_sensor_mclk1_default &cam_sensor_front_default>;
		pinctrl-1 = <&cam_sensor_mclk1_sleep &cam_sensor_front_sleep>;
		gpios = <&msm_gpio 27 0>,
			<&msm_gpio 28 0>,
			<&msm_gpio 33 0>;
		qcom,gpio-reset = <1>;
		qcom,gpio-standby = <2>;
		qcom,gpio-req-tbl-num = <0 1 2>;
		qcom,gpio-req-tbl-flags = <1 0 0>;
		qcom,gpio-req-tbl-label = "CAM1_MCLK",
			"CAM1_RESET",
			"CAM1_STANDBY";
		qcom,sensor-position = <1>;
		qcom,sensor-mode = <0>;			
		status = "ok";
		clocks = <&clock_gcc clk_mclk1_clk_src>,
				<&clock_gcc clk_gcc_camss_mclk1_clk>;
		clock-names = "cam_src_clk", "cam_clk";
	};
*/
};
